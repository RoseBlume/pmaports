/* Used for enchilada, fajita, axolotl, and db845c */
/dts-v1/;
/ {
        #address-cells = <2>;
        #size-cells = <2>;
        qcom,msm-id = <0x141 0x20001>;
        qcom,board-id = <8 0 18801 41>;
        memory {
                /* We expect the bootloader to fill in the size */
                reg = <0 0 0 0>;
        };

        chosen { };
};